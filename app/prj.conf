## CMakeLists.txt
```
# SPDX-License-Identifier: Apache-2.0

cmake_minimum_required(VERSION 3.20.0)

# Find Zephyr package - works with both ZEPHYR_BASE and west workspace
find_package(Zephyr REQUIRED HINTS $ENV{ZEPHYR_BASE})
project(blinky)

target_sources(app PRIVATE src/main.c)

target_include_directories(app 
    PRIVATE ${CMAKE_SOURCE_DIR}/cfg 
)

# Add a custom post-build step to rename the hex file
#add_custom_command(
#    TARGET app
#    POST_BUILD
#    COMMAND ${CMAKE_COMMAND} -E copy
#    $<TARGET_FILE:zephyr_final.elf>
#    ${CMAKE_CURRENT_BINARY_DIR}/viser-runner.elf
#    COMMENT "Renaming zephyr.elf to viser-runner.elf"
#)
```

## prj.conf
```kconfig
# STM32U585 IoT Discovery Kit (b_u585i_iot02a) Configuration

# Basic peripherals
CONFIG_GPIO=y

# Console and debugging
CONFIG_PRINTK=y
CONFIG_CONSOLE=y
CONFIG_UART_CONSOLE=y

# CPU usage monitoring (supported on STM32U585)
CONFIG_CPU_LOAD=y

# System heap - STM32U585 has 786KB SRAM, so this is safe
CONFIG_HEAP_MEM_POOL_SIZE=32768
CONFIG_SYS_HEAP_RUNTIME_STATS=y

# STM32U585 Power Management - Well supported
CONFIG_PM=y
CONFIG_PM_DEVICE=y
CONFIG_PM_DEVICE_RUNTIME=y

# Enable custom PM policy to set default behavior
CONFIG_PM_POLICY_CUSTOM=y

# STM32U585 supports these power modes
#CONFIG_PM_STATE_SUSPEND_TO_IDLE_SUPPORTED=y
#CONFIG_PM_STATE_STANDBY_SUPPORTED=y

# Logging for PM debugging
CONFIG_LOG=y
CONFIG_LOG_DEFAULT_LEVEL=3

# STM32 specific optimizations
# CONFIG_SOC_FAMILY_STM32=y
# CONFIG_SOC_SERIES_STM32U5X=y

# Enable system workqueue for delayed work (needed for k_work_schedule)
CONFIG_SYSTEM_WORKQUEUE_STACK_SIZE=2048

# Clock configuration for better power management
CONFIG_CLOCK_CONTROL=y

# Flash controller for power management
CONFIG_FLASH=y
```

## src/main.c
```c
#include <zephyr/kernel.h>
#include <zephyr/sys/printk.h>

/* CPU load */
#include <zephyr/debug/cpu_load.h>      /* cpu_load_get() */

/* Heap (RAM) stats */
#include <zephyr/sys/sys_heap.h>
#include <zephyr/sys/mem_stats.h>
extern struct sys_heap _system_heap;    /* system heap backing k_malloc() */

/* Power management notifier (older API: state_entry/state_exit only) */
#include <zephyr/pm/pm.h>

#include <buildCfg.h>
#include <inputCfg.h>


static int64_t  sleep_enter_ms = -1;
static uint64_t total_sleep_ms = 0;
static uint64_t sleep_per_reporting_cycle_ms = 0;

static void pm_state_entry_cb(enum pm_state state)
{
    printk("PM: Entering power state %d\n", state);
    // Track all power states, including SUSPEND_TO_IDLE
    sleep_enter_ms = k_uptime_get();
}

static void pm_state_exit_cb(enum pm_state state)
{
    printk("PM: Exiting power state %d\n", state);
    // Track sleep time for all power states
    if (sleep_enter_ms >= 0) {
        int64_t dt = k_uptime_get() - sleep_enter_ms;
        if (dt > 0) {
            total_sleep_ms += (uint64_t)dt;
            sleep_per_reporting_cycle_ms += (uint64_t)dt;
        }
        sleep_enter_ms = -1;
    }
}

/* Correct notifier for this API */
static struct pm_notifier pm_nb = {
    .state_entry = pm_state_entry_cb,
    .state_exit  = pm_state_exit_cb,
};

void main(void)
{
#if IS_ENABLED(CONFIG_PM)
    pm_notifier_register(&pm_nb);
#endif

    const uint32_t report_period_ms = 5000;
    uint64_t last_print_ms = k_uptime_get();
    uint32_t counter = 0;

    while (1) {

        uint64_t now = k_uptime_get();
        //report system performance every report_period_ms
        if ((now - last_print_ms) >= report_period_ms) {
            /* CPU load: per-mille -> percent */
            int load_pm  = cpu_load_get(true);   /* reset measurement window */
            int load_pct = (load_pm >= 0) ? (load_pm / 10) : -1;

            uint64_t up_ms   = now;
            uint64_t run_ms  = up_ms - total_sleep_ms;

            if (load_pct >= 0) {
                printk("CPU=%d%% | Uptime=%llu ms (Run=%llu, Sleep=%llu, SleepPerCycle=%llu)\n",
                       load_pct,
                       up_ms, run_ms, total_sleep_ms, sleep_per_reporting_cycle_ms);
            } else {
                printk("CPU=%s | Uptime=%llu ms (Run=%llu, Sleep=%llu, SleepPerCycle=%llu) \n",
                       (load_pct >= 0) ? "n/a" : "n/a",
                       up_ms, run_ms, total_sleep_ms, sleep_per_reporting_cycle_ms);
            }
            sleep_per_reporting_cycle_ms = 0;
            last_print_ms = now;
        }

        //go to sleep deep sleep based on input config
        if (counter < SLEEP_CYCLE) {
            printk("Start of short sleep\n");
            k_sleep(K_MSEC(100));
        }else{
            printk("Start of long sleep\n");
            counter = 0;
            k_sleep(K_MSEC(1000));
        }
        counter++;
    }
}

/* Custom Power Management Policy - Makes your settings the default */
#if IS_ENABLED(CONFIG_PM_POLICY_CUSTOM)

const struct pm_state_info *pm_policy_next_state(uint8_t cpu, int32_t ticks)
{
    /* Default power state configuration - your desired settings */
    static const struct pm_state_info default_suspend_to_idle = {
        .state = PM_STATE_SUSPEND_TO_IDLE,
        .substate_id = 0,
        .min_residency_us = 500,    /* Must sleep at least 500us to be worthwhile */
        .exit_latency_us = 100       /* Takes 100μs to wake up */
    };

    /* Convert ticks to microseconds for comparison */
    uint32_t idle_us = k_ticks_to_us_ceil32(ticks);
    
    /* Only enter power state if idle time is sufficient */
    if (idle_us >= default_suspend_to_idle.min_residency_us) {
        printk("PM Policy: Entering SUSPEND_TO_IDLE (idle=%u us)\n", idle_us);
        return &default_suspend_to_idle;
    }
    return NULL;
}

#endif /* CONFIG_PM_POLICY_CUSTOM */
```
